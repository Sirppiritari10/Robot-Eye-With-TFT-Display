#include "Sprites.h"






// Draw an RGB565 sprite with "black = transparent" rule
void drawRGBBitmapTransparent(
    Adafruit_GFX &tft,
    int16_t x, int16_t y,
    const uint16_t *bitmap,
    int16_t w, int16_t h
) {
    int16_t i, j;
    uint16_t pixel;

    for (j = 0; j < h; j++) {
        for (i = 0; i < w; i++) {

            pixel = bitmap[j * w + i];

            // FAST transparency rule: skip black pixels
            if (pixel == 0x0000) {
                continue;
            }

            tft.drawPixel(x + i, y + j, pixel);
        }
    }
}

static inline uint16_t tint565(
    uint16_t color,
    uint16_t tintColor,
    uint8_t amount)
{
    // Extract RGB565 components
    uint8_t r1 = (color >> 11) & 0x1F;
    uint8_t g1 = (color >> 5)  & 0x3F;
    uint8_t b1 =  color        & 0x1F;

    uint8_t r2 = (tintColor >> 11) & 0x1F;
    uint8_t g2 = (tintColor >> 5)  & 0x3F;
    uint8_t b2 =  tintColor        & 0x1F;

    // Integer interpolation
    r1 = r1 + (((int16_t)(r2 - r1) * amount) >> 8);
    g1 = g1 + (((int16_t)(g2 - g1) * amount) >> 8);
    b1 = b1 + (((int16_t)(b2 - b1) * amount) >> 8);

    return (r1 << 11) | (g1 << 5) | b1;
}


// Draw an RGB565 bitmap with a specified tint
void drawRGBBitmapTinted(
    Adafruit_GFX &canvas,
    int16_t x,
    int16_t y,
    const uint16_t *bitmap,
    int16_t w,
    int16_t h,
    uint16_t tintColor,
    uint8_t tintAmount)
{
    for (int16_t row = 0; row < h; row++) {
        const uint16_t *src = bitmap + row * w;

        for (int16_t col = 0; col < w; col++) {

            uint16_t pixel = src[col];

            // Black = transparent
            if (pixel == 0x0000)
                continue;

            pixel = tint565(pixel, tintColor, tintAmount);

            canvas.drawPixel(x + col, y + row, pixel);
        }
    }
}







// Resolution: 128 x 128
const uint16_t sprite_eye_sclera[128*128] = {
  0x0000, 0x0000, 0x0000, 0x0000, 0x0000, 0x0000, 0x0000, 0x0000, 0x0000, 0x0000, 
  0x0000, 0x0000, 0x0000, 0x0000, 0x0000, 0x0000, 0x0000, 0x0000, 0x0000, 0x0000, 
  0x0000, 0x0000, 0x0000, 0x0000, 0x0000, 0x0000, 0x0000, 0x0000, 0x0000, 0x0000, 
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  0x0000, 0x0000, 0x0000, 0x0000
};

const Sprite SPRITE_EYE_SCLERA = {
    sprite_eye_sclera,
    128,
    128
};

// ------------------------------------------------------

const uint16_t sprite_eye_iris[100*100] PROGMEM = {
  0x0000, 0x0000, 0x0000, 0x0000, 0x0000, 0x0000, 0x0000, 0x0000, 0x0000, 0x0000, 
  0x0000, 0x0000, 0x0000, 0x0000, 0x0000, 0x0000, 0x0000, 0x0000, 0x0000, 0x0000, 
  0x0000, 0x0000, 0x0000, 0x0000, 0x0000, 0x0000, 0x0000, 0x0000, 0x0000, 0x0000, 
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  0x0000, 0x0000, 0x0000, 0x0000, 0x0000, 0x0000, 0x0000, 0x0000, 0x0000, 0x0000
};



const Sprite SPRITE_EYE_IRIS = {
    sprite_eye_iris,
    100,
    100
};

// ------------------------------------------------------

const uint16_t sprite_question_mark[] = { 0x0000 };

const Sprite SPRITE_QUESTION_MARK = {
    sprite_question_mark,
    16,
    16
};

// ------------------------------------------------------

const uint16_t sprite_exclamation[] = { 0x0000 };

const Sprite SPRITE_EXCLAMATION = {
    sprite_exclamation,
    16,
    16
};